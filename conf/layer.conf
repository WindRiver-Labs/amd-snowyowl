## conf/layer.conf
```bitbake
#
# Copyright (C) 2020 Wind River Systems, Inc.
#

# We have a conf and classes directory, add to BBPATH
BBPATH =. "${LAYERDIR}:"

# We have a packages directory, add to BBFILES
BBFILES += "${LAYERDIR}/recipes-*/*/*.bb \
	${LAYERDIR}/recipes-*/*/*.bbappend"

BBFILE_COLLECTIONS += "wr-amd-snowyowl"
BBFILE_PATTERN_wr-amd-snowyowl = "^${LAYERDIR}/"
BBFILE_PRIORITY_wr-amd-snowyowl = "7"

# This should only be incremented on significant changes that will
# cause compatibility issues with other layers
LAYERVERSION_wr-amd-snowyowl = "1"

LAYERDEPENDS_wr-amd-snowyowl = "core wrlinux"

LAYERSERIES_COMPAT_wr-amd-snowyowl = "warrior zeus wrl"
```

## conf/machine/amd-snowyowl.conf
```bitbake
#
# Copyright (C) 2020 Wind River Systems, Inc.
#
#@TYPE: Machine
#@NAME: amd-snowyowl
#@DESCRIPTION: Machine configuration for AMD snowyowl systems

require conf/machine/include/tune-snowyowl.inc
require conf/machine/amd-snowyowl.inc

# multilib support
MULTILIBS ?= "multilib:lib32"
DEFAULTTUNE_virtclass-multilib-lib32 ?= "x86"

KARCH = "x86-64"
KMACHINE_amd-snowyowl = "amd-x86"

MACHINE_FEATURES_remove = "qemu-usermode"
```

## conf/machine/amd-snowyowl.inc
```bitbake
#
# Copyright (C) 2018 Wind River Systems, Inc.
#

MACHINE_FEATURES += "x86 pci usbhost ext2 keyboard screen alsa acpi vfat serial"
MACHINE_FEATURES += "efi pcbios"
MACHINE_EXTRA_RRECOMMENDS += "linux-firmware-radeon"

EFI_PROVIDER ?= "${@bb.utils.contains('INCOMPATIBLE_LICENSE', 'GPLv3', 'systemd-boot', 'grub-efi', d)}"

# grub-efi is depended in wic.bbclass, remove it to aviod depency error.
WKS_FILE_DEPENDS_BOOTLOADERS_remove = "${@bb.utils.contains('INCOMPATIBLE_LICENSE', 'GPLv3', 'grub-efi', '', d)}"

# Do not include installer routine when GPLv3 is not allowed.
INITRAMFS_SCRIPTS_remove = "${@bb.utils.contains('INCOMPATIBLE_LICENSE', 'GPLv3', 'initramfs-module-install initramfs-module-install-efi', '', d)}"
LABELS_LIVE_remove = "${@bb.utils.contains('INCOMPATIBLE_LICENSE', 'GPLv3', 'install', '', d)}"

KERNEL_IMAGETYPE = "bzImage"

SERIAL_CONSOLES = "115200;ttyS0"


XSERVER ?= "xserver-xorg \
           xserver-xorg-extension-dri \
           xserver-xorg-extension-dri2 \
           xserver-xorg-extension-glx \
           xserver-xorg-extension-extmod \
           xserver-xorg-extension-dbe \
           xserver-xorg-module-libint10 \
           xf86-input-mouse \
           xf86-input-keyboard \
           xf86-input-evdev \
           xf86-input-synaptics \
           xf86-video-vesa \
           xf86-video-fbdev \
           xf86-video-intel \
           xf86-video-mga \
           xf86-video-modesetting \
           xf86-video-ati \
           mesa \
           mesa-driver-radeon \
           mesa-driver-swrast \
           mesa-demos \
           matchbox-wm"

PREFERRED_PROVIDER_libglu = "libglu"
PREFERRED_PROVIDER_libdrm = "libdrm"
PREFERRED_VERSION_virtual/mesa = "17.1.5"

PREFERRED_VERSION_grub-efi ?= "2.04"

PREFERRED_PROVIDER_virtual/kernel ??= "linux-yocto"
PREFERRED_VERSION_linux-yocto ?= "5.2%"

PREFERRED_VERSION_autoconf-archive ?= "2019.01.06"

IMAGE_FSTYPES += "wic wic.bmap live"
WKS_FILE ?= "${@bb.utils.contains('INCOMPATIBLE_LICENSE', 'GPLv3', 'systemd-bootdisk.wks', 'mkefidisk.wks', d)}"
do_image_wic[depends] += "gptfdisk-native:do_populate_sysroot"
do_image_wic[recrdeptask] += "do_bootimg"

PACKAGECONFIG_pn-gnome-common = " autoconf-archive"
```
